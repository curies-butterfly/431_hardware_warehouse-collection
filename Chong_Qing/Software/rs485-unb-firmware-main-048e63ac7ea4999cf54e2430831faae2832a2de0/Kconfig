## Chong_Qing/Software/rs485-unb-firmware-main-048e63ac7ea4999cf54e2430831faae2832a2de0/Kconfig
```kconfig
mainmenu "RT-Thread Configuration"

config BSP_DIR
    string
    option env="BSP_ROOT"
    default "."

config RTT_DIR
    string
    option env="RTT_ROOT"
    default "rt-thread"

config PKGS_DIR
    string
    option env="PKGS_ROOT"
    default "packages"

config PLATFORM_DIR
    string
    option env="PLATFORM_DIR"
    default  "E:/01_work/Chong_Qing/Software/rs485-unb-firmware-main-048e63ac7ea4999cf54e2430831faae2832a2de0/platform"

source "$RTT_DIR/Kconfig"
source "$PKGS_DIR/Kconfig"
source "$PKGS_DIR/packages/misc/samples/Kconfig"

config RT_STUDIO_BUILT_IN
    bool
    select ARCH_ARM_CORTEX_M4
    select RT_USING_COMPONENTS_INIT
    select RT_USING_USER_MAIN
    default y
```
